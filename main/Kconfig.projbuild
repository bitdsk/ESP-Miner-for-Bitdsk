## main/Kconfig.projbuild
```kconfig
menu "Bitdsk Configuration"
    config ASIC_VOLTAGE
        int "ASIC Core Voltage (mV)"
        range 1000 1800
        default 1300
        help
            The core voltage to set the ASIC to. 1200 for BM1366 or 1400 for BM1397 is typical.

    config ASIC_FREQUENCY
        int "ASIC Hash Frequency (MHz)"
        range 50 800
        default 300
        help
            The BM1397 hash frequency
endmenu

menu "Stratum Configuration"

    config STRATUM_URL
        string "Stratum Address"
        default "solo.vkbit.com"
        help
            The example will connect to this Stratum pool address.

    config STRATUM_PORT
        int "Stratum Port"
        range 0 65535
        default 3333
        help
            The stratum server port to connect to.

    config STRATUM_USER
        string "Stratum username"
        default "19ac4otHjzmbPpyKodYHvVCwzTnT4gQGjA.bitdsk"
        help
            Stratum user to use with pool

    config STRATUM_PASS
        string "Stratum password"
        default "x"
        help
            Stratum password to use with pool

    config STRATUM_DIFFICULTY
        int "Stratum default difficulty"
        range 0 4294967296
        default 128
        help
            A starting difficulty to use with the pool.

endmenu
```
